## Kconfig
```kconfig
mainmenu "embedded_sim"

source "Kconfig.zephyr"

menu "Simulations"

config SIM_SENSORS
	bool "Sensor simulation"
config SIM_SCADA
	bool "SCADA simulation"
config SIM_ROBOTICS
	bool "Robotics simulation"
config SIM_PUMPS
	bool "Pump simulation"
config SIM_WEBSERVER
	bool "Device-hosted web UI + live WebSocket"
	depends on SIM_WIFI
	select SIM_TELEMETRY
	select HTTP_SERVER
	select HTTP_SERVER_WEBSOCKET

config SIM_TELEMETRY
	bool
	select CBPRINTF_FP_SUPPORT
	help
	  Telemetry bus (net/telemetry): sims publish, MQTT/WebSocket sinks consume.

config SIM_DEFAULT_PERIOD_MS
	int "Default simulation period (ms), overridable per simulation"
	default 100

config SIM_MAX_TASKS
	int "Maximum number of simulation threads"
	default 8

config SIM_TASK_STACK_SIZE
	int "Stack size per simulation thread"
	default 2048

config SIM_STATS_PERIOD_S
	int "Log real-time task statistics every N seconds (0 = off)"
	default 10

config SIM_WEBSERVER_PORT
	int "Web server TCP port"
	default 80
	depends on SIM_WEBSERVER

config SIM_WS_MAX_CLIENTS
	int "Max simultaneous WebSocket viewers"
	default 3
	depends on SIM_WEBSERVER

config SIM_WS_QUEUE_LEN
	int "WebSocket outgoing sample queue length"
	default 16
	depends on SIM_WEBSERVER

endmenu

menu "Wi-Fi"

config SIM_WIFI
	bool "Join a Wi-Fi network at boot"

config SIM_WIFI_SSID
	string "SSID"
	depends on SIM_WIFI

config SIM_WIFI_PSK
	string "Passphrase (empty = open network)"
	depends on SIM_WIFI

config SIM_STATIC_IPV4
	string "Static IPv4 address (empty = DHCP)"
	depends on SIM_WIFI

config SIM_GATEWAY_IPV4
	string "Gateway"
	default "192.168.1.1"
	depends on SIM_WIFI

config SIM_NETMASK_IPV4
	string "Netmask"
	default "255.255.255.0"
	depends on SIM_WIFI

endmenu

menu "MQTT"

config SIM_DEVICE_ID
	string "Device id used in topics and as MQTT client id ([a-z0-9_-])"
	default "dev-01"

config SIM_MQTT
	bool "Publish telemetry over MQTT"
	depends on SIM_WIFI
	select MQTT_LIB
	select SIM_TELEMETRY

if SIM_MQTT

config SIM_MQTT_BROKER
	string "Broker IPv4 address"
	default "192.168.1.147"

config SIM_MQTT_PORT
	int "Broker port"
	default 1883

config SIM_MQTT_USER
	string "Username (empty = anonymous)"

config SIM_MQTT_PASSWORD
	string "Password"

config SIM_MQTT_KEEPALIVE_S
	int "Keepalive (s)"
	default 30

config SIM_MQTT_QUEUE_LEN
	int "Outgoing sample queue length"
	default 16

endif # SIM_MQTT

endmenu
```
